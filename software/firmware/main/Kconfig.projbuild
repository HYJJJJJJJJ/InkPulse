## software/firmware/main/Kconfig.projbuild
```kconfig
menu "InkPulse Panel"

choice INKPULSE_PANEL
    prompt "EPD panel"
    default PANEL_UC8179_BWR_750
    help
        选择物理墨水屏型号(编译期固定, 一块板只焊一块屏)。

    config PANEL_UC8179_BWR_750
        bool "7.5\" 800x480 BWR (UC8179)"

    config PANEL_SSD1677_BW_426
        bool "4.2\" 480x800 BW partial-refresh (SSD1677)"
endchoice

endmenu
```

## software/firmware/sdkconfig.defaults
```kconfig
CONFIG_ESP_CONSOLE_UART_DEFAULT=y
CONFIG_ESPTOOLPY_FLASHSIZE_8MB=y
CONFIG_FREERTOS_HZ=1000
# 自定义分区表(app 扩到 2MB, 容纳 BLE 协议栈)
CONFIG_PARTITION_TABLE_CUSTOM=y
CONFIG_PARTITION_TABLE_CUSTOM_FILENAME="partitions.csv"
# 蓝牙: 启用 NimBLE(省 flash/RAM)
CONFIG_BT_ENABLED=y
CONFIG_BT_NIMBLE_ENABLED=y
```
